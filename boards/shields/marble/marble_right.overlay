#include "marble.dtsi"


&default_transform {
    col-offset = <6>;
};


&default_kscan {
     col-gpios =     <&gpio0 17 GPIO_ACTIVE_LOW>,
                    <&gpio0 20 GPIO_ACTIVE_LOW>,
                    <&gpio0 22 GPIO_ACTIVE_LOW>,
                    <&gpio0 24 GPIO_ACTIVE_LOW>,
                    <&gpio1  0 GPIO_ACTIVE_LOW>,
                    <&gpio0 11 GPIO_ACTIVE_LOW>,
                    <&gpio1  4 GPIO_ACTIVE_LOW>;
}; 