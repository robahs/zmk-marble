## boards/shields/marble/Kconfig.defconfig
```kconfig
if SHIELD_MARBLE_RIGHT

config ZMK_KEYBOARD_NAME
  default "Marmortastatur"

config ZMK_SPLIT_ROLE_CENTRAL
  default y

endif


if SHIELD_MARBLE_LEFT || SHIELD_MARBLE_RIGHT

config ZMK_SPLIT
  default y

config BT
  default y

config ZMK_BLE 
  default y

endif
```

## boards/shields/marble/Kconfig.shield
```kconfig
config SHIELD_MARBLE_RIGHT
    def_bool $(shields_list_contains,marble_right)

config SHIELD_MARBLE_LEFT
    def_bool $(shields_list_contains,marble_left)
```
